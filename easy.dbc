VERSION "Excel 2 DBC"

NS_ :

BS_:

BU_: Engine Display Light
VAL_TABLE_ OnOff 0 "Off" 1 "On";

BO_ 291 EngineState: 2 Engine
 SG_ EngineSpeed : 1|15@1- (1,0) [0|0] "rpm" Display
 SG_ OnOff : 0|1@1+ (1,0) [0|0] "" Display

BO_ 801 LightState: 1 Light
 SG_ FlashLight : 2|1@1+ (1,0) [0|1] "" Display
 SG_ HeadLight : 0|1@1+ (1,0) [0|1] "" Display

BA_DEF_ BO_ "GenMsgCycleTime" INT 0 65535;
BA_ "GenMsgCycleTime" BO_ 291 100;
BA_ "GenMsgCycleTime" BO_ 801 100;
VAL_ 291 OnOff 0 "Off" 1 "On";
