VERSION "Excel 2 DBC"

NS_ :

BS_:

BU_: Virtual

BO_ 1798 AnlyzInfo6: 8 Virtual
 SG_ Counter : 32|16@1+ (1,0) [0|0] "" Vector__XXX
 SG_ I6CurrentCycle : 0|32@1+ (0.01,0) [0.5|1000] "ms" Vector__XXX

BO_ 1797 AnlyzInfo5: 8 Virtual
 SG_ Counter : 32|16@1+ (1,0) [0|0] "" Vector__XXX
 SG_ I5CurrentCycle : 0|32@1+ (0.01,0) [0.5|1000] "ms" Vector__XXX

BO_ 1796 AnlyzInfo4: 8 Virtual
 SG_ Counter : 32|16@1+ (1,0) [0|0] "" Vector__XXX
 SG_ I4CurrentCycle : 0|32@1+ (0.01,0) [0.5|1000] "ms" Vector__XXX

BO_ 1795 AnlyzInfo3: 8 Virtual
 SG_ Counter : 32|16@1+ (1,0) [0|0] "" Vector__XXX
 SG_ I3CurrentCycle : 0|32@1+ (0.01,0) [0.5|1000] "ms" Vector__XXX

BO_ 1794 AnlyzInfo2: 8 Virtual
 SG_ Counter : 32|16@1+ (1,0) [0|0] "" Vector__XXX
 SG_ I2CurrentCycle : 0|32@1+ (0.01,0) [0.5|1000] "ms" Vector__XXX

BO_ 1793 AnlyzInfo1: 8 Virtual
 SG_ Counter : 32|16@1+ (1,0) [0|0] "" Vector__XXX
 SG_ I1CurrentCycle : 0|32@1+ (0.01,0) [0.5|1000] "ms" Vector__XXX

BA_DEF_ SG_ "GenSigStartValue" FLOAT 0 100000000000;
BA_ "GenSigStartValue" SG_ 1798 I6CurrentCycle 50;
BA_ "GenSigStartValue" SG_ 1797 I5CurrentCycle 50;
BA_ "GenSigStartValue" SG_ 1796 I4CurrentCycle 50;
BA_ "GenSigStartValue" SG_ 1795 I3CurrentCycle 50;
BA_ "GenSigStartValue" SG_ 1794 I2CurrentCycle 50;
BA_ "GenSigStartValue" SG_ 1793 I1CurrentCycle 50;
