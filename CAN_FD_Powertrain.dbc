VERSION "Excel 2 DBC"

NS_ :

BS_:

BU_: Engine Gateway
VAL_TABLE_ Gear 0 "Idle" 1 "Gear_1" 2 "Gear_2" 3 "Gear_3" 4 "Gear_4" 5 "Gear_5";
VAL_TABLE_ Status 0 "WakeUp" 1 "Running" 2 "GoSleep" 3 "Error";
VAL_TABLE_ ShiftRequest 0 "Shift_Request_Off" 1 "Shift_Request_On";
VAL_TABLE_ Gear 0 "Idle" 1 "Gear_1" 2 "Gear_2" 3 "Gear_3" 4 "Gear_4" 5 "Gear_5";
VAL_TABLE_ IdleRunning 0 "Running" 1 "Idle";
VAL_TABLE_ GearLock 0 "Gear_Lock_Off" 1 "Gear_Lock_On";

BO_ 3221225472 VECTOR__INDEPENDENT_SIG_MSG: 0 Vector__XXX
 SG_ EngInjectionVol : 0|64@1- (1,0) [0|0] "" Vector__XXX

BO_ 1793 FallbackMessage: 12 Engine
 SG_ FallbackMessage_Byte_06_10 : 55|48@0- (1,0) [0|0] "" Vector__XXX
 SG_ FallbackMessage_Byte_00_05 : 7|48@0- (1,0) [0|0] "" Vector__XXX

BO_ 1792 DropOutMessage: 32 Engine
 SG_ DropOutMessage_Byte_06_10 : 55|48@0- (1,0) [0|0] "" Vector__XXX
 SG_ DropOutMessage_Byte_00_05 : 7|48@0- (1,0) [0|0] "" Vector__XXX

BO_ 2047 Test_Message_CAN_FD: 64 Engine
 SG_ Test_signal_Byte_56_62 : 448|52@1- (1,0) [-2251799813685250|2251799813685250] "" Vector__XXX
 SG_ Test_signal_Byte_49_55 : 392|52@1- (1,0) [-2251799813685250|2251799813685250] "" Vector__XXX
 SG_ Test_Signal_Byte_63 : 504|8@1- (1,0) [0|0] "" Vector__XXX
 SG_ Test_Signal_Byte_06_09 : 48|32@1+ (1,0) [0|0] "" Vector__XXX
 SG_ Test_Signal_Byte_03_05 : 24|24@1- (1,0) [0|0] "" Vector__XXX
 SG_ Test_signal_Byte_42_48 : 336|52@1- (1,0) [-2251799813685250|2251799813685250] "" Vector__XXX
 SG_ Test_Signal_Byte_35_41 : 280|52@1- (1,0) [-2251799813685250|2251799813685250] "" Vector__XXX
 SG_ Test_Signal_Byte_28_34 : 224|52@1- (1,0) [-2251799813685250|2251799813685250] "" Vector__XXX
 SG_ Test_Signal_Byte_21_27 : 168|52@1- (1,0) [-2251799813685250|2251799813685250] "" Vector__XXX
 SG_ Test_Signal_Byte_15_20 : 120|48@1- (1,0) [-140737488355328|140737488355327] "" Vector__XXX
 SG_ Test_Signal_Byte_10_14 : 80|40@1- (1,0) [0|0] "" Vector__XXX
 SG_ Test_Signal_Byte_01_02 : 8|16@1- (1,0) [0|0] "" Vector__XXX
 SG_ Test_Signal_Byte_00 : 0|8@1- (1,0) [0|0] "" Vector__XXX

BO_ 72048 Ignition_Info: 48 Gateway
 SG_ StarterKey : 0|1@1+ (1,0) [0|1] "" Engine

BO_ 1307 NM_Engine: 4 Engine
 SG_ SleepInd : 0|1@1+ (1,0) [0|1] "" Vector__XXX

BO_ 1020 GearBoxInfo: 32 Engine
 SG_ Gear : 0|3@1+ (1,0) [0|5] "" Vector__XXX

BO_ 101 EngineStatus: 24 Engine
 SG_ EngStatusFD_FillByte4 : 64|16@1- (1,0) [0|0] "" Vector__XXX
 SG_ EngStatusFD_FillByte3 : 32|24@1- (1,0) [0|0] "" Vector__XXX
 SG_ EngStatusFD_FillByte2 : 16|8@1- (1,0) [0|0] "" Vector__XXX
 SG_ EngStatusFD_FillByte1 : 8|8@1- (1,0) [0|0] "" Vector__XXX
 SG_ ErrorCode : 2|6@1+ (1,0) [0|0] "" Vector__XXX
 SG_ Status : 0|2@1+ (1,0) [0|0] "" Vector__XXX

BO_ 100 EngineData: 64 Engine
 SG_ EngKnocking : 464|48@1- (1,0) [0|0] "" Vector__XXX
 SG_ EngIgnitionAngle : 400|64@1- (1,0) [0|0] "" Vector__XXX
 SG_ EngStates : 336|64@1- (1,0) [0|0] "" Vector__XXX
 SG_ EngValvePos : 272|64@1- (1,0) [0|0] "" Vector__XXX
 SG_ EngTubePressure : 208|64@1- (1,0) [0|0] "" Vector__XXX
 SG_ SleepInd : 201|1@1+ (1,0) [0|1] "" Vector__XXX
 SG_ ShiftRequest : 200|1@1+ (1,0) [0|0] "" Vector__XXX
 SG_ Gear : 44|3@1+ (1,0) [0|5] "" Vector__XXX
 SG_ EcoMode : 42|2@1+ (1,0) [0|1] "" Vector__XXX
 SG_ EngTorque : 128|64@1- (1,0) [0|0] "" Vector__XXX
 SG_ EngSpeed : 96|16@1- (1,0) [-32768|32767] "rpm" Vector__XXX
 SG_ EngForce : 64|32@1+ (1,0) [0|0] "N" Vector__XXX
 SG_ PetrolLevel : 24|8@1+ (1,0) [0|255] "l" Vector__XXX
 SG_ EngPower : 48|16@1+ (0.01,0) [0|150] "kW" Vector__XXX
 SG_ IdleRunning : 15|1@1+ (1,0) [0|0] "" Vector__XXX
 SG_ EngTemp : 16|7@1+ (2,-50) [-50|150] "degC" Vector__XXX

BO_ 51525 ABSdata: 12 Engine
 SG_ AccelarationForce : 32|16@1+ (1,-10000) [0|0] "N" Vector__XXX
 SG_ Diagnostics : 16|8@1+ (1,0) [0|0] "" Vector__XXX
 SG_ GearLock : 15|1@1+ (1,0) [0|0] "" Vector__XXX
 SG_ CarSpeed : 0|10@1+ (0.5,0) [0|300] "mph" Vector__XXX

BA_DEF_ BO_ "GenMsgCycleTime" INT 0 65535;
BA_DEF_ BO_ "VFrameFormat" ENUM  "StandardCAN","ExtendedCAN","reserved","reserved","reserved","reserved","reserved","reserved","reserved","reserved","reserved","reserved","reserved","reserved","StandardCAN_FD","ExtendedCAN_FD";
BA_DEF_ SG_ "GenSigStartValue" FLOAT 0 100000000000;
BA_DEF_  "BusType" STRING;
BA_ "BusType"   "CAN FD";
BA_ "VFrameFormat" BO_ 3221225472 0;
BA_ "VFrameFormat" BO_ 1793 14;
BA_ "VFrameFormat" BO_ 1792 14;
BA_ "GenMsgCycleTime" BO_ 2047 100;
BA_ "VFrameFormat" BO_ 2047 14;
BA_ "GenMsgCycleTime" BO_ 72048 50;
BA_ "VFrameFormat" BO_ 72048 14;
BA_ "GenMsgCycleTime" BO_ 1307 100;
BA_ "VFrameFormat" BO_ 1307 0;
BA_ "GenMsgCycleTime" BO_ 1020 50;
BA_ "VFrameFormat" BO_ 1020 14;
BA_ "GenMsgCycleTime" BO_ 101 10;
BA_ "VFrameFormat" BO_ 101 14;
BA_ "GenMsgCycleTime" BO_ 100 100;
BA_ "VFrameFormat" BO_ 100 14;
BA_ "GenMsgCycleTime" BO_ 51525 50;
BA_ "VFrameFormat" BO_ 51525 14;
BA_ "GenSigStartValue" SG_ 100 EngTemp 25;
BA_ "GenSigStartValue" SG_ 51525 AccelarationForce 10000;
VAL_ 1020 Gear 0 "Idle" 1 "Gear_1" 2 "Gear_2" 3 "Gear_3" 4 "Gear_4" 5 "Gear_5";
VAL_ 101 Status 0 "WakeUp" 1 "Running" 2 "GoSleep" 3 "Error";
VAL_ 100 ShiftRequest 0 "Shift_Request_Off" 1 "Shift_Request_On";
VAL_ 100 Gear 0 "Idle" 1 "Gear_1" 2 "Gear_2" 3 "Gear_3" 4 "Gear_4" 5 "Gear_5";
VAL_ 100 IdleRunning 0 "Running" 1 "Idle";
VAL_ 51525 GearLock 0 "Gear_Lock_Off" 1 "Gear_Lock_On";
